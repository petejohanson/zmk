## app/boards/arm/waveshare_rp2040_zero/Kconfig.board
```kconfig
# Copyright (c) 2021 Pete Johanson
# SPDX-License-Identifier: Apache-2.0

config BOARD_WAVESHARE_RP2040_ZERO
	bool "Waveshare RP2040 Zero Board"
	depends on SOC_RP2040
```

## app/boards/arm/waveshare_rp2040_zero/Kconfig.defconfig
```kconfig
# Copyright (c) 2021 Pete Johanson
# SPDX-License-Identifier: Apache-2.0

if BOARD_SEEEDUINO_XIAO_RP2040

config BOARD
	default "seeeduino_xiao_rp2040"

config RP2_FLASH_W25Q080
	default y

endif # BOARD_SEEEDUINO_XIAO_RP2040
```

## app/boards/arm/waveshare_rp2040_zero/waveshare_rp2040_zero_defconfig
```kconfig
# SPDX-License-Identifier: Apache-2.0

CONFIG_SOC_SERIES_RP2XXX=y
CONFIG_SOC_RP2040=y
CONFIG_BOARD_ADAFRUIT_QT_PY_RP2040=y

CONFIG_SYS_CLOCK_HW_CYCLES_PER_SEC=240000000

# Enable GPIO
CONFIG_GPIO=y

# enable uart driver
CONFIG_SERIAL=y

# enable console
CONFIG_CONSOLE=y
CONFIG_UART_CONSOLE=y

# Code partition needed to target the correct flash range
CONFIG_USE_DT_CODE_PARTITION=y

# Output UF2 by default, native bootloader supports it.
CONFIG_BUILD_OUTPUT_UF2=y
```

## app/module/drivers/Kconfig
```kconfig
# Copyright (c) 2020 The ZMK Contributors
# SPDX-License-Identifier: MIT

rsource "fuel_gauge/Kconfig"
rsource "gpio/Kconfig"
rsource "kscan/Kconfig"
rsource "sensor/Kconfig"
rsource "display/Kconfig"
rsource "input/Kconfig"
```

## app/module/drivers/fuel_gauge/Kconfig
```kconfig
# Copyright (c) 2020-2021 The ZMK Contributors
# SPDX-License-Identifier: MIT

config ZMK_BATTERY
    bool "ZMK battery monitoring"
    help
        Enable battery monitoring

rsource "battery_voltage/Kconfig"
rsource "max17048/Kconfig"
rsource "nrf_vddh/Kconfig"
rsource "sensor/Kconfig"
```

## app/module/drivers/fuel_gauge/battery_voltage/Kconfig
```kconfig
# Copyright (c) 2025 The ZMK Contributors
# SPDX-License-Identifier: MIT

config ZMK_FUEL_GAUGE_VOLTAGE
    bool
    default DT_HAS_ZMK_FUEL_GAUGE_VOLTAGE_ENABLED
    select SENSOR
    select ZMK_BATTERY
    depends on FUEL_GAUGE
    help
        Enable battery voltage driver for battery monitoring.
```

## app/module/drivers/fuel_gauge/nrf_vddh/Kconfig
```kconfig
# Copyright (c) 2025 The ZMK Contributors
# SPDX-License-Identifier: MIT

config ZMK_BATTERY_NRF_VDDH
    bool
    default DT_HAS_ZMK_BATTERY_NRF_VDDH_ENABLED
    select ADC
    select ZMK_BATTERY
    depends on FUEL_GAUGE
    help
        Enable ZMK nRF VDDH voltage driver for battery monitoring.
```

## app/module/drivers/fuel_gauge/sensor/Kconfig
```kconfig
# Copyright (c) 2025 The ZMK Contributors
# SPDX-License-Identifier: MIT

config ZMK_FUEL_GAUGE_SENSOR
    bool
    default DT_HAS_ZMK_FUEL_GAUGE_SENSOR_ENABLED
    select SENSOR
    select ZMK_BATTERY
    depends on FUEL_GAUGE
    help
        Enable fuel gauge sensor driver for battery monitoring.
```

## app/module/drivers/sensor/Kconfig
```kconfig
# Copyright (c) 2020 The ZMK Contributors
# SPDX-License-Identifier: MIT

if SENSOR

rsource "ec11/Kconfig"

rsource "encoder_mock/Kconfig"

endif # SENSOR
```

## app/module/dts/bindings/fuel_gauge/zmk,fuel-gauge-sensor.yaml
```yaml
# Copyright (c) 2025 The ZMK Contributors
# SPDX-License-Identifier: MIT

description: \
  Battery SoC monitoring using a fuel gauge written with the sensor API

  This driver wraps one of the fuel gauge drivers that was written with the
  sensor API (e.g. maxim,max17055, maxim,max17262, or ti,bq274xx) so it supports
  the fuel gauge API and can be used for ZMK battery monitoring.

compatible: "zmk,fuel-gauge-sensor"

properties:
  sensor:
    type: phandle
    required: true
    description: The fuel gauge sensor to read
```

## app/module/dts/bindings/fuel_gauge/zmk,fuel-gauge-voltage.yaml
```yaml
# Copyright (c) 2020 The ZMK Contributors
# SPDX-License-Identifier: MIT

description: Battery SoC monitoring using a battery voltage sensor

compatible: "zmk,fuel-gauge-voltage"

properties:
  sensor:
    type: phandle
    required: true
    description: The voltage divider or other voltage sensor to read
```
